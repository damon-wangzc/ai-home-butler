## esp32s3-ai/main/Kconfig.projbuild
```kconfig
menu "AI Orb Configuration"

    config AI_ORB_WIFI_SSID
        string "WiFi SSID"
        default ""
        help
            Name of the WiFi network to connect to.

    config AI_ORB_WIFI_PASSWORD
        string "WiFi Password"
        default ""
        help
            Password for the WiFi network.

    config AI_ORB_ORCHESTRATOR_HOST
        string "Orchestrator Host IP"
        default "192.168.1.10"
        help
            IP address of the butler orchestrator (WSL or DELL).

    config AI_ORB_ORCHESTRATOR_WS_PORT
        int "Orchestrator WebSocket Port"
        default 8000
        help
            Port for the WebSocket /audio endpoint.

    config AI_ORB_MQTT_HOST
        string "MQTT Broker Host"
        default ""
        help
            IP address of the Mosquitto MQTT broker.
            Leave blank to use the same host as the orchestrator.

    config AI_ORB_USER_ID
        string "User ID"
        default "kid"
        help
            User ID sent in MQTT butler/user/context messages.

    config AI_ORB_WAKE_WORD
        string "Wake Word Model"
        default "wn9_hilexin"
        help
            ESP-SR wake word model name.

endmenu
```

## esp32s3-ai/sdkconfig.defaults
```kconfig
# Waveshare ESP32-S3-Touch-LCD-1.85 — AI Orb default config
# Flash: 16MB (w25q128), PSRAM: 8MB OPI

# Flash & PSRAM
CONFIG_ESPTOOLPY_FLASHSIZE_16MB=y
CONFIG_ESPTOOLPY_FLASHMODE_QIO=y
CONFIG_ESPTOOLPY_FLASHFREQ_80M=y
CONFIG_SPIRAM=y
CONFIG_SPIRAM_MODE_OCT=y
CONFIG_SPIRAM_SPEED_80M=y
CONFIG_SPIRAM_USE_MALLOC=y
CONFIG_SPIRAM_MALLOC_ALWAYSINTERNAL=4096
CONFIG_SPIRAM_ALLOW_BSS_SEG_EXTERNAL_MEMORY=y

# CPU
CONFIG_ESP32S3_DEFAULT_CPU_FREQ_240=y

# FreeRTOS
CONFIG_FREERTOS_HZ=1000

# LVGL (via idf_component_manager)
# Tune buffer sizes — face animations need smooth DMA
CONFIG_LV_MEM_SIZE=131072
CONFIG_LV_ATTRIBUTE_FAST_MEM_USE_IRAM=y

# Partition table
CONFIG_PARTITION_TABLE_CUSTOM=y
CONFIG_PARTITION_TABLE_CUSTOM_FILENAME="partitions.csv"

# Logging
CONFIG_LOG_DEFAULT_LEVEL_INFO=y

# ESP-SR wake word
CONFIG_SR_MN_CN_HILEXIN=y
CONFIG_SR_WN_WN9_HILEXIN=y

# WebSocket (esp-protocols component)
CONFIG_WS_TRANSPORT_MAX_CONTROL_FRAME_BUFFER_SIZE=512
CONFIG_WS_BUFFER_SIZE=8192
```
